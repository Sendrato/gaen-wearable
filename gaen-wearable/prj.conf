## CMakeLists.txt
```
# SPDX-License-Identifier: Apache-2.0

cmake_minimum_required(VERSION 3.13.1)

#find_package(Zephyr HINTS $ENV{ZEPHYR_BASE})
include($ENV{ZEPHYR_BASE}/cmake/app/boilerplate.cmake NO_POLICY_SCOPE)

project(ct_wearable)

target_sources(app
        PRIVATE
            src/main.c

            src/ct_app_en.c
            src/ct_app_enc.c
            src/ct_settings.c
            src/ct_crypto.c
            src/ct_db.c

            src/tinycrypt/hkdf.c

            src/bluetooth/basa.c
            src/bluetooth/ctsa.c
            src/bluetooth/disa.c

            src/util/reboot.c
            src/util/ui.c
            src/util/battery.c
        )

zephyr_include_directories(src)
zephyr_include_directories(src/bluetooth)
zephyr_include_directories(src/util)
```

## prj.conf
```kconfig
CONFIG_NEWLIB_LIBC=y

# Increased stack due too settings-API usage
CONFIG_SYSTEM_WORKQUEUE_STACK_SIZE=2048

CONFIG_SYS_POWER_MANAGEMENT=y
CONFIG_SYS_POWER_DEEP_SLEEP_STATES=n
CONFIG_REBOOT=y
CONFIG_SYS_PM_STATE_LOCK=y
CONFIG_DEVICE_POWER_MANAGEMENT=y
CONFIG_REBOOT=y

CONFIG_LOG_BLOCK_IN_THREAD=y
CONFIG_LOG_STRDUP_MAX_STRING=64
CONFIG_LOG_STRDUP_BUF_COUNT=16

CONFIG_BT=y
CONFIG_BT_BROADCASTER=y
CONFIG_BT_OBSERVER=y
CONFIG_BT_PERIPHERAL=y
CONFIG_BT_DEBUG_LOG=y

# BT pairing settings
CONFIG_BT_KEYS_OVERWRITE_OLDEST=y
CONFIG_BT_SETTINGS=y

CONFIG_BT_PRIVACY=n
CONFIG_BT_ID_MAX=2
CONFIG_BT_SMP=y
CONFIG_BT_SMP_SC_ONLY=y
CONFIG_BT_FIXED_PASSKEY=y
CONFIG_BT_MAX_PAIRED=2

CONFIG_BT_GATT_DYNAMIC_DB=y
CONFIG_BT_RX_BUF_LEN=258
CONFIG_BT_DATA_LEN_UPDATE=y
CONFIG_BT_CTLR_TX_BUFFER_SIZE=251
CONFIG_BT_CTLR_DATA_LENGTH_MAX=251
CONFIG_BT_CTLR_ADVANCED_FEATURES=y
CONFIG_BT_RX_BUF_LEN=258
CONFIG_BT_L2CAP_TX_MTU=247
CONFIG_BT_L2CAP_DYNAMIC_CHANNEL=y

CONFIG_BT_LL_SW_SPLIT=y

CONFIG_TINYCRYPT=y
CONFIG_TINYCRYPT_SHA256=y
CONFIG_TINYCRYPT_SHA256_HMAC=y
CONFIG_TINYCRYPT_SHA256_HMAC_PRNG=y
CONFIG_TINYCRYPT_AES=y
CONFIG_TINYCRYPT_AES_CTR=y

CONFIG_HWINFO=y

CONFIG_FLASH=y
CONFIG_FLASH_PAGE_LAYOUT=y
CONFIG_FLASH_MAP=y

CONFIG_SETTINGS=y
CONFIG_SETTINGS_RUNTIME=y

## Nordic specific setup
CONFIG_NVS=y
CONFIG_SETTINGS_NVS=y
CONFIG_ARM_MPU=n

CONFIG_POSIX_CLOCK=y

CONFIG_SHELL=n

CONFIG_ENTROPY_GENERATOR=y

CONFIG_ADC=y
CONFIG_ADC_NRFX_SAADC=y
```

## src/main.c
```c
/*
 * This file is part of the Contact Tracing / GAEN Wearable distribution
 *        https://github.com/Sendrato/gaen-wearable.
 *
 * Copyright (c) 2020 Vincent van der Locht (https://www.synchronicit.nl/)
 *                    Hessel van der Molen  (https://sendrato.com/)
 *
 * This program is free software: you can redistribute it and/or modify
 * it under the terms of the GNU Affero General Public License as published by
 * the Free Software Foundation, version 3.
 *
 * This program is distributed in the hope that it will be useful, but
 * WITHOUT ANY WARRANTY; without even the implied warranty of
 * MERCHANTABILITY or FITNESS FOR A PARTICULAR PURPOSE. See the GNU
 * General Public License for more details.
 *
 * You should have received a copy of the GNU Affero General Public License along
 * with this program. If not, see <https://www.gnu.org/licenses/agpl-3.0.txt>.
 */

#include <zephyr/types.h>
#include <stddef.h>
#include <stdio.h>

#include <sys/printk.h>
#include <sys/util.h>

#include <settings/settings.h>

#include <bluetooth/bluetooth.h>
#include <bluetooth/hci.h>

#include "ct.h"
#include "ui.h"
#include "ct_app_en.h"
#include "ct_app_enc.h"

#include "ct_crypto.h"
#include "ct_db.h"

#include <logging/log.h>

LOG_MODULE_REGISTER(ct_main, LOG_LEVEL_INF);

static ct_app_id_t _app = CT_APP_MAIN;

void btn_callback(int btn, uint8_t clk)
{
    if(clk == UI_BTN_LONGPRESS) {
        LOG_DBG("long press");
        // Stop current active app.
        // => start of new app is handled in app-callback.

        if (_app == CT_APP_ENC) {
            ct_app_enc_stop();
        } else if (_app == CT_APP_EN) {
            ct_app_en_stop();
        } else {
            LOG_ERR("invalid app is active");
        }

    } else {
        LOG_DBG("%d clicks", clk);
    }
}

void ct_app_event(ct_app_id_t app, ct_event_t event)
{
    if ( event == CT_EVENT_BATTERY_EMPTY ) {
        ui_led_blink(UI_LED_RED, 3);
    }

    if(app == CT_APP_ENC) {
        // When ENC is stopped, start EN.
        if(event == CT_EVENT_STOP) {
            _app = CT_APP_EN;
            ct_app_en_start();
            ui_led_off(UI_LED_GREEN);
            ui_haptic_blink(1);
        }

    } else if(app == CT_APP_EN) {

        switch ( event ) {
            // When EN is stopped, start ENC.
            case CT_EVENT_STOP:
                _app = CT_APP_ENC;
                ct_app_enc_start();
                ui_led_blink(UI_LED_GREEN, UI_BLINK_INFINITE);
                ui_haptic_blink(5);
                break;

            case CT_EVENT_START_SCAN:
                ui_led_blink(UI_LED_GREEN, 1);
                ui_led_blink(UI_LED_RED  , 1);
                break;

            case CT_EVENT_NEW_RPI:
                ui_led_blink(UI_LED_GREEN, 2);
                ui_led_blink(UI_LED_RED  , 2);
                break;

            case CT_EVENT_INVALID_CLOCK:
                ui_led_blink(UI_LED_RED, 1);
                ui_haptic_blink(1);
                break;

            case CT_EVENT_ENOMEM:
                ui_led_blink(UI_LED_BLUE, 3);
                ui_haptic_blink(2);
                break;

            default:
                break;
        }
    }
}

void main(void)
{
    int err = bt_enable(NULL);
    if (err) {
        LOG_ERR("Bluetooth init failed (err %d)\n", err);
        return;
    }

    if (IS_ENABLED(CONFIG_SETTINGS)) {
        settings_load();
    }

    printk("Contact Tracing Wearable\n");

    ui_init();
    ui_btn_set_callback(btn_callback);

    ct_crypto_init();
    ct_db_init();

    ct_app_en_init();
    ct_app_enc_init();

    //Start GAEN stack.
    _app = CT_APP_EN;
    ct_app_en_start();

    do {
        k_sleep(K_FOREVER);
    } while (1);
}
```

## src/ct.h
```c
/*
 * This file is part of the Contact Tracing / GAEN Wearable distribution
 *        https://github.com/Sendrato/gaen-wearable.
 *
 * Copyright (c) 2020 Vincent van der Locht (https://www.synchronicit.nl/)
 *                    Hessel van der Molen  (https://sendrato.com/)
 *
 * This program is free software: you can redistribute it and/or modify
 * it under the terms of the GNU Affero General Public License as published by
 * the Free Software Foundation, version 3.
 *
 * This program is distributed in the hope that it will be useful, but
 * WITHOUT ANY WARRANTY; without even the implied warranty of
 * MERCHANTABILITY or FITNESS FOR A PARTICULAR PURPOSE. See the GNU
 * General Public License for more details.
 *
 * You should have received a copy of the GNU Affero General Public License along
 * with this program. If not, see <https://www.gnu.org/licenses/agpl-3.0.txt>.
 */

/**
 * @file
 * @brief Contact Tracing (GAEN) wide definitions and default settings.
 */

#ifndef __CT_H
#define __CT_H

#include <string.h>
#include <zephyr/types.h>

#define CT_INFO_MODEL "CT WEARABLE"
#define CT_INFO_MANUF "SynchronicIT/Sendrato"
#define CT_INFO_FWREV "v1.0.0"

/**
 * @def CT_BATT_TYPE
 * @brief Type of battery which is used.
 *
 * Battery status is calculacted based on the type of used battery.
 * See util/battery.h for options.
 */
#define CT_BATT_TYPE lipo

/**
 * @def CT_DEFAULT_DEVICENAME
 * @brief Device name.
 *
 * The device name will be published with bluetooth advertisments when the
 * wearable is put in config-mode. The device name should be 10 characters long.
 */
#define CT_DEFAULT_DEVICENAME "CTWEARABLE"

/**
 * @def CT_DEFAULT_BT_ADV_PERIOD
 * @brief Duration of GAEN advertisement period in milliseconds.
 *
 * The GAEN stack alternates between advertisement and scanning. This define
 * specifies the duration [in milliseconds] of the advertisement period.
 */
#define CT_DEFAULT_BT_ADV_PERIOD  4500

/**
 * @def CT_DEFAULT_BT_SCAN_PERIOD
 * @brief Duration of GAEN scanning period in milliseconds.
 *
 * The GAEN stack alternates between advertisement and scanning. This define
 * specifies the duration [in milliseconds] of the scanning period.
 */
#define CT_DEFAULT_BT_SCAN_PERIOD  500

/**
 * @def CT_DEFAULT_BT_ADV_IVAL_MIN
 * @brief Minimum interval in between consecutive GAEN advertisements.
 *
 * Specified according to the Bluetooth Specification in steps of 0.625ms.
 * Default value: 320 * 0.625 = 200 [ms]
 */
#define CT_DEFAULT_BT_ADV_IVAL_MIN  320

/**
 * @def CT_DEFAULT_BT_ADV_IVAL_MAX
 * @brief Maximum interval in between consecutive GAEN advertisements.
 *
 * Specified according to the Bluetooth Specification in steps of 0.625ms.
 * Default value: 432 * 0.625 = 270 [ms]
 */
#define CT_DEFAULT_BT_ADV_IVAL_MAX  432

/**
 * @def CT_DEFAULT_BT_SCAN_IVAL
 * @brief Scan interval during the GAEN Scanning period.
 *
 * Specified according to the Bluetooth Specification in steps of 0.625ms.
 * Default value: 96 * 0.625 = 60 [ms]
 */
#define CT_DEFAULT_BT_SCAN_IVAL    96

/**
 * @def CT_DEFAULT_BT_SCAN_WINDOW
 * @brief Scan window during the GAEN Scanning period.
 *
 * Specified according to the Bluetooth Specification in steps of 0.625ms.
 * Default value: 48 * 0.625 = 30 [ms]
 */
#define CT_DEFAULT_BT_SCAN_WINDOW  48

/**
 * @def CT_DEFAULT_TEK_IVAL
 * @brief TEK Rolling Interval
 */
#define CT_DEFAULT_TEK_IVAL    600

/**
 * @def CT_DEFAULT_TEK_IVAL
 * @brief TEK Rolling Period
 */
#define CT_DEFAULT_TEK_PERIOD  144

// GAEN data-size definitions
#define TEK_SIZE      16
#define RPIK_SIZE     16
#define RPI_SIZE      16
#define AEMK_SIZE     16
#define AEM_SIZE       4
#define META_SIZE      4

/**
 * @typedef ct_app_id_t
 * @brief Contact Tracing Applications which can be acivated.
 */
typedef enum {
    CT_APP_MAIN = 0,    /**< Main application. Triggered after bootup */
    CT_APP_EN,          /**< GAEN application */
    CT_APP_ENC,         /**< GAEN config application. Used to offload data */
} ct_app_id_t;

/**
 * @typedef ct_event_t
 * @brief Application events.
 */
typedef enum {
    /* Generic events */
    CT_EVENT_NONE = 0,
    CT_EVENT_START,
    CT_EVENT_STOP,
    CT_EVENT_BATTERY_EMPTY,

    /* EN events */
    CT_EVENT_NEW_TEK = 64,
    CT_EVENT_NEW_RPI,
    CT_EVENT_START_ADV,
    CT_EVENT_START_SCAN,

    /* ENC events */
    CT_EVENT_CONNECTED = 128,
    CT_EVENT_DISCONNECTED,

    /* Error events */
    CT_EVENT_ERROR = -1,
    CT_EVENT_INVALID_CLOCK,
    CT_EVENT_ENOMEM,
} ct_event_t;

/**
* @brief Callback for applications to notify events.
* @param [in] app   : application which triggers the call @ref ct_app_id_t
* @param [in] event : @ref ct_event_t
*/
void ct_app_event(ct_app_id_t app, ct_event_t event);

#endif /* __CT_H */
```

## src/ct_app_en.c
```c
/*
 * This file is part of the Contact Tracing / GAEN Wearable distribution
 *        https://github.com/Sendrato/gaen-wearable.
 *
 * Copyright (c) 2020 Vincent van der Locht (https://www.synchronicit.nl/)
 *                    Hessel van der Molen  (https://sendrato.com/)
 *
 * This program is free software: you can redistribute it and/or modify
 * it under the terms of the GNU Affero General Public License as published by
 * the Free Software Foundation, version 3.
 *
 * This program is distributed in the hope that it will be useful, but
 * WITHOUT ANY WARRANTY; without even the implied warranty of
 * MERCHANTABILITY or FITNESS FOR A PARTICULAR PURPOSE. See the GNU
 * General Public License for more details.
 *
 * You should have received a copy of the GNU Affero General Public License along
 * with this program. If not, see <https://www.gnu.org/licenses/agpl-3.0.txt>.
 */

#include <zephyr/types.h>
#include <stddef.h>
#include <stdio.h>

#include <sys/printk.h>
#include <sys/util.h>

#include <time.h>
#include <posix/time.h>
#include <posix/sys/time.h>

#include <bluetooth/bluetooth.h>
#include <bluetooth/hci.h>
#include <bluetooth/conn.h>
#include <bluetooth/uuid.h>
#include <bluetooth/gatt.h>

#include "ct.h"
#include "ct_app_en.h"
#include "ct_app_state.h"
#include "ct_settings.h"
#include "ct_db.h"
#include "ct_crypto.h"

#include "battery.h"

#include <logging/log.h>

LOG_MODULE_REGISTER(app_en, LOG_LEVEL_INF);

// App states and worker queue
static app_state_t _en_state = APP_STATE_UNDEF; // active/stopped indicator
static struct k_delayed_work _en_state_work;
// setup&start en_app worker
static void app_en_state_start(struct k_work *work);
// run adv-period and schedule scan-period
static void app_en_state_adv(struct k_work *work);
// start scan-period and schedule adv-period.
static void app_en_state_scan(struct k_work *work);

/************* BT PARAMS ***************/

static uint8_t _en_bt_service_data[22] = { 0x6f,0xfd,
                'T', 'E', 'S', 'T',
                'T', 'E', 'S', 'T',
                'T', 'E', 'S', 'T',
                'T', 'E', 'S', 'T',
                'A', 'E', 'M', 'D' };

static struct bt_data _en_bt_ad[] = {
    BT_DATA_BYTES(BT_DATA_FLAGS, 0x1A),
    BT_DATA_BYTES(BT_DATA_UUID16_ALL, 0x6F,0xFD ),
    BT_DATA(BT_DATA_SVC_DATA16, _en_bt_service_data, sizeof(_en_bt_service_data))
};

static struct bt_le_adv_param  _en_bt_adv_param;
static struct bt_le_scan_param _en_bt_scan_param;

/************ EN PARAMS *****************/

static uint8_t _en_key_rpik[RPIK_SIZE];
static uint8_t _en_key_rpi[RPI_SIZE];
static uint8_t _en_key_aemk[AEMK_SIZE];
static uint8_t _en_key_aem[AEM_SIZE];

// TEK should be updated every 24 hours.
//   This function updates TEK if required, so when called more frequent then
//   once every 24 hours, TEK will be updated properly.
//   As this function depends on a random number generator, TEK-update is guarded
//   by comparing ENIntervalNumber and the contents of the last TEK.
static void en_tek_update( uint32_t ival )
{
    uint8_t  last_tek[TEK_SIZE];
    uint32_t last_ival;
    uint8_t  curr_tek[TEK_SIZE];
    uint32_t curr_ival;

    // Fetch last tek from database
    int err = ct_db_tek_get_last(last_tek, &last_ival);

    // no item in database, so ensure "tek_last" is NULL
    if (err) {
        last_ival = 0;
        memset(last_tek, 0, TEK_SIZE);
    }

    // get aligned interval number of current TEKRollingPeriod and compute tek
    //  which responds with this period.
    curr_ival = ival;

    // Check if the aligned IntervalNumbers match. This indicates that the
    //   current timeframe is still within the last timeframe.
    // When the IntervalNumbers match, check if the last key is none-empty.
    //   if empty, we should generate a new key, if not, we should not update.
    if ((last_ival <= curr_ival) &&
            ((last_ival + ct_priv.tek_rolling_period) > curr_ival) )
        {
        for(int i=0;i<TEK_SIZE; i++) {
            if (last_tek[i] != 0) {
                return;
            }
        }
    }

    // Update keys if new tek needs to be created.
    ct_crypto_calc_tek(curr_tek);
    ct_db_tek_add(curr_tek, curr_ival);
    ct_crypto_calc_rpik(curr_tek, _en_key_rpik);
    ct_crypto_calc_aemk(curr_tek, _en_key_aemk);

    LOG_DBG(" >> @ ival %i ", curr_ival);
    LOG_HEXDUMP_DBG(curr_tek, TEK_SIZE, " >> New TEK:");
    LOG_HEXDUMP_DBG(_en_key_rpik, RPIK_SIZE, " >> New RPIK:");
    LOG_HEXDUMP_DBG(_en_key_aemk, AEMK_SIZE, " >> New AEMK:");

    ct_app_event(CT_APP_EN, CT_EVENT_NEW_TEK);
}


// RPI should be updated every 10 minutes or when TEK is updated.
//  RPI and AEM are recalculated every function call. No check or safe-guard
//  is added as these functions do not contain randomness, so providing the same
//  RPIK, AEMK, metadata and ENIntervalNumber, the output should also be the same.
static void en_rpi_update( uint32_t ival )
{
    int enin_j = ival;
    ct_crypto_calc_rpi(enin_j, _en_key_rpik, _en_key_rpi);
}

static void en_aem_update(void)
{
    uint8_t metadata[4];
    metadata[0] = 0x40; // version
    metadata[1] = 0x00; // tx_power == 0dBm
    metadata[2] = 0x00; // reserved
    metadata[3] = 0x00; // reserved

    // AEM calculation adjusts "RPI", as this is used as counter.
    // ==> Copy RPI to ensure this update will not propagate through this FW
    uint8_t rpi_ctr[RPI_SIZE];
    memcpy(rpi_ctr,_en_key_rpi,RPI_SIZE);
    ct_crypto_calc_aem(_en_key_aemk, rpi_ctr, metadata, _en_key_aem);
}

static void en_bt_scan_cb(const bt_addr_le_t *addr, int8_t rssi,
            uint8_t adv_type, struct net_buf_simple *ad)
{
    int ret;
    char rpi_str[80];

    if (adv_type != BT_GAP_ADV_TYPE_ADV_NONCONN_IND) {
        return;
    }

    while (ad->len > 1) {
        uint8_t len = net_buf_simple_pull_u8(ad);
        uint8_t type;

        // Check for early termination
        if (len == 0U) {
            LOG_DBG("AD len = 0");
            return;
        }

        if (len > ad->len) {
            LOG_DBG("AD malformed");
            return;
        }

        type = net_buf_simple_pull_u8(ad);

        if (type == BT_DATA_UUID16_ALL) {
            if(ad->data[0] == 0x6F && ad->data[1] == 0xfd) {
                LOG_INF("\tCT Service");
            }
        } else if (type == BT_DATA_SVC_DATA16) {
            if(ad->data[0] == 0x6F && ad->data[1] == 0xfd) {

                char le_addr[BT_ADDR_LE_STR_LEN];
                bt_addr_le_to_str(addr, le_addr, sizeof(le_addr));

                memset(rpi_str, 0, sizeof(rpi_str));
                for(int i = 0; i<20; i++) {
                    snprintf(&rpi_str[i*3], sizeof(rpi_str) - i*3,
                                " %02X", ad->data[i+2]);
                }
                LOG_INF("\tCT RPI %s @ %i [dB] from %s", log_strdup(rpi_str),
                                rssi, log_strdup(le_addr));

                // insert RPI into database
                ret = ct_db_rpi_add(&ad->data[2], &ad->data[2+RPI_SIZE], rssi,
                            ct_crypto_intervalNumber_now());
                if (ret == ENOMEM) {
                    ct_app_event(CT_APP_EN, CT_EVENT_ENOMEM);
                }
            }
        }

        net_buf_simple_pull(ad, len - 1);
    }
}

/************* EN_APP STATES ***************/

static void app_en_state_start(struct k_work *work)
{
    LOG_DBG("state: START");
    ct_app_event(CT_APP_EN, CT_EVENT_START);

    // Stop all BT activity
    bt_le_adv_stop();
    bt_le_scan_stop();

    // Setup advertisment data
    APP_STATE_NOW_WQ(app_en_state_adv);
}


static void app_en_state_adv(struct k_work *work)
{
    int err;
    LOG_DBG("state: ADV");
    ct_app_event(CT_APP_EN, CT_EVENT_START_ADV);

    // As the adv-state in the GAEN stack will run most often, check battery.
    static uint8_t batt_sample_cnt = 0;
    if (batt_sample_cnt++ > 10) {
        batt_sample_cnt = 0;
        int batt_mV = battery_sample();
        if(batt_mV >= 0) {
            int batt_percent = battery_level_pptt(batt_mV, CT_BATT_TYPE) / 100;
            if (batt_percent < 5)
                ct_app_event(CT_APP_EN, CT_EVENT_BATTERY_EMPTY);
        }
    }

    // Stop scanning activity
    bt_le_scan_stop();

    struct timespec now;
    clock_gettime(CLOCK_REALTIME, &now);

    // Ensure internal clock is set to a proper value as the EN depends
    // heavily on the concept of (a correct) time. Note that we cannot check
    // what the correct value should be, but we know that the value should be
    // aleast after 01-Jan-2020, 00:00 [epoch: 1577836800]
    if (now.tv_sec < 1577836800) {
        ct_app_event(CT_APP_EN, CT_EVENT_INVALID_CLOCK);
        APP_STATE_NEXT_WQ(app_en_state_adv, K_MSEC(ct_priv.adv_period));
        return;
    }

    uint8_t rpi_old[RPI_SIZE];
    memcpy(rpi_old, _en_key_rpi, RPI_SIZE);

    //Update advertisement data
    // => implicitly updates '_en_key_rpi' among others.

    uint32_t ival = ct_crypto_intervalNumber_now();
    // Update TEK. Function is safe-guared against over-use.
    // => should change every 24h
    en_tek_update( ival );
    // Update RPI and AEM. Functions are not safe-guarded, but as they do not
    //  use random generators, output is the same upon every call if the same
    //  input is provided.
    en_rpi_update( ival );
    en_aem_update();
    // Sent tick to db.
    ct_db_tick( ival );


    // Reset advertisment when RPI has changed
    if ( memcmp(rpi_old, _en_key_rpi, RPI_SIZE) != 0 ) {

        LOG_INF("@ival: %i", ct_crypto_intervalNumber_now());
        LOG_HEXDUMP_INF(_en_key_rpi, RPI_SIZE, " >> New RPI");
        LOG_HEXDUMP_INF(_en_key_aem, AEM_SIZE, " >> New AEM ");

        // Stop advertising so we can update all parameters
        err = bt_le_adv_stop();
        if (err) {
            LOG_ERR("Advertising failed to stop (err %d)", err);
        }

        for(int i = 0; i< RPI_SIZE; i++) {
            _en_bt_service_data[i+2] = _en_key_rpi[i];
        }

        for(int i = 0; i< AEM_SIZE; i++) {
            _en_bt_service_data[i+2+RPI_SIZE] = _en_key_aem[i];
        }

        // reset BLE ID
        bt_id_reset(_en_bt_adv_param.id, NULL, NULL);

        // Force the usage of the identity address.
        //  This address will change every time `bt_le_adv_start` is called.
        _en_bt_adv_param.options      = (BT_LE_ADV_OPT_USE_IDENTITY);

        // Update ADV interval.
        _en_bt_adv_param.interval_min = ct_priv.adv_ival_min;
        _en_bt_adv_param.interval_max = ct_priv.adv_ival_max;

        // Start advertising
        // ==> will generate a new mac address for the advertisement!
        err = bt_le_adv_start(&_en_bt_adv_param, _en_bt_ad,
                        ARRAY_SIZE(_en_bt_ad), NULL, 0);
        if (err) {
            LOG_ERR("Advertising failed to start (err %d)", err);
        }
    }

    APP_STATE_NEXT_WQ(app_en_state_scan, K_MSEC(ct_priv.adv_period));
}


static void app_en_state_scan(struct k_work *work)
{
    LOG_DBG("state: SCAN");
    ct_app_event(CT_APP_EN, CT_EVENT_START_SCAN);

    // Do not stop Advertisemens as this will update the BT mac-address.

    // Setup of scan-paramets.
    // ==> Scan passivly, i.e. do not request scan-responses.
    _en_bt_scan_param.type       = BT_HCI_LE_SCAN_PASSIVE;
    // ==> Ignore duplicate advertisements during a single scan period.
    _en_bt_scan_param.options    = BT_LE_SCAN_OPT_FILTER_DUPLICATE;
    _en_bt_scan_param.interval   = ct_priv.scan_ival;
    _en_bt_scan_param.window     = ct_priv.scan_window;

    // Start scanning..
    int err = bt_le_scan_start(&_en_bt_scan_param, en_bt_scan_cb);
    if (err) {
        LOG_ERR("Scanning failed to start (err %d)", err);
    }

    // Scanning ==> Advertising
    APP_STATE_NEXT_WQ(app_en_state_adv, K_MSEC(ct_priv.scan_period));
}


/************* EN_APP CTRL ***************/

int ct_app_en_init(void)
{
    bt_addr_le_t addrs[CONFIG_BT_ID_MAX];
    size_t count = CONFIG_BT_ID_MAX;

    bt_id_get(addrs, &count);

    if(count<2) {
        _en_bt_adv_param.id = bt_id_create(NULL, NULL);
    } else {
        _en_bt_adv_param.id = 1;
    }

    return 0;
}

int ct_app_en_start(void)
{
    _en_state = APP_STATE_ACTIVE;
    //delayed start to allow other apps to close down (open) BT connections
    APP_STATE_NEXT(&_en_state_work, app_en_state_start, K_MSEC(2000));

    LOG_INF("EN APP start");

    return 0;
}

int ct_app_en_stop(void)
{
    _en_state = APP_STATE_STOPPED;
    APP_STATE_CLEAR(&_en_state_work);

    bt_le_scan_stop();
    bt_le_adv_stop();

    LOG_INF("EN APP stop");

    ct_app_event(CT_APP_EN, CT_EVENT_STOP);

    return 0;
}
```

## src/ct_app_en.h
```c
/*
 * This file is part of the Contact Tracing / GAEN Wearable distribution
 *        https://github.com/Sendrato/gaen-wearable.
 *
 * Copyright (c) 2020 Vincent van der Locht (https://www.synchronicit.nl/)
 *                    Hessel van der Molen  (https://sendrato.com/)
 *
 * This program is free software: you can redistribute it and/or modify
 * it under the terms of the GNU Affero General Public License as published by
 * the Free Software Foundation, version 3.
 *
 * This program is distributed in the hope that it will be useful, but
 * WITHOUT ANY WARRANTY; without even the implied warranty of
 * MERCHANTABILITY or FITNESS FOR A PARTICULAR PURPOSE. See the GNU
 * General Public License for more details.
 *
 * You should have received a copy of the GNU Affero General Public License along
 * with this program. If not, see <https://www.gnu.org/licenses/agpl-3.0.txt>.
 */

/**
 * @file
 * @brief Contact Tracing / GAEN application.
 *
 * This file holds the Contact Tracing / Google-Apple Exposure Notication
 * application. It manages the required crypto, Bluetooth stack, address
 * rotations, TEK and RPI updates.
 */

#ifndef __CT_APP_EN_H
#define __CT_APP_EN_H

#include <string.h>
#include <zephyr/types.h>

/**
 * @brief Initialise the EN-application.
 * @return 0 on success, negative errno code on failure.
 */
int ct_app_en_init(void);

/**
 * @brief Start the EN-application.
 *
 * This is a none-blocking call. The application will start / allocate resources
 * after a small amount of time to allow other apps to gracefully terminate.
 *
 * @return 0 on success, negative errno code on failure.
 */
int ct_app_en_start(void);

/**
 * @brief Stop the EN-application.
 *
 * This is a none-blocking call. After this call the application will
 * gracefully terminate any open connections and clean up system allocations.
 *
 * @return 0 on success, negative errno code on failure.
 */
int ct_app_en_stop(void);

#endif /* __CT_APP_EN_H */
```

## src/ct_app_enc.h
```c
/*
 * This file is part of the Contact Tracing / GAEN Wearable distribution
 *        https://github.com/Sendrato/gaen-wearable.
 *
 * Copyright (c) 2020 Vincent van der Locht (https://www.synchronicit.nl/)
 *                    Hessel van der Molen  (https://sendrato.com/)
 *
 * This program is free software: you can redistribute it and/or modify
 * it under the terms of the GNU Affero General Public License as published by
 * the Free Software Foundation, version 3.
 *
 * This program is distributed in the hope that it will be useful, but
 * WITHOUT ANY WARRANTY; without even the implied warranty of
 * MERCHANTABILITY or FITNESS FOR A PARTICULAR PURPOSE. See the GNU
 * General Public License for more details.
 *
 * You should have received a copy of the GNU Affero General Public License along
 * with this program. If not, see <https://www.gnu.org/licenses/agpl-3.0.txt>.
 */

/**
 * @file
 * @brief Contact Tracing / GAEN configuration application.
 *
 * When this app is active a BLE Central Device is able to connect to the
 * wearable to retrieve stored TEK/RPI data and to update protocol settings.
 */

#ifndef __CT_APP_ENC_H
#define __CT_APP_ENC_H

#include <string.h>
#include <zephyr/types.h>

/**
 * @brief Initialise the ENC-application.
 * @return 0 on success, negative errno code on failure.
 */
int ct_app_enc_init(void);

/**
 * @brief Start the ENC-application.
 *
 * This is a none-blocking call. The application will start / allocate resources
 * after a small amount of time to allow other apps to gracefully terminate.
 *
 * @return 0 on success, negative errno code on failure.
 */
int ct_app_enc_start(void);

/**
 * @brief Stop the ENC-application.
 *
 * This is a none-blocking call. After this call the application will
 * gracefully terminate any open connections and clean up system allocations.
 *
 * @return 0 on success, negative errno code on failure.
 */
int ct_app_enc_stop(void);

#endif /* __CT_APP_ENC_H */
```

## src/ct_app_state.h
```c
/*
 * This file is part of the Contact Tracing / GAEN Wearable distribution
 *        https://github.com/Sendrato/gaen-wearable.
 *
 * Copyright (c) 2020 Vincent van der Locht (https://www.synchronicit.nl/)
 *                    Hessel van der Molen  (https://sendrato.com/)
 *
 * This program is free software: you can redistribute it and/or modify
 * it under the terms of the GNU Affero General Public License as published by
 * the Free Software Foundation, version 3.
 *
 * This program is distributed in the hope that it will be useful, but
 * WITHOUT ANY WARRANTY; without even the implied warranty of
 * MERCHANTABILITY or FITNESS FOR A PARTICULAR PURPOSE. See the GNU
 * General Public License for more details.
 *
 * You should have received a copy of the GNU Affero General Public License along
 * with this program. If not, see <https://www.gnu.org/licenses/agpl-3.0.txt>.
 */

/**
 * @file
 * @brief Helpers to manage app-state and their worker-queue.
 *
 * Helpers which are postfixed with "_WQ" should only be used in the
 * worker-queue task itself. These helpers depend on data provided by the task.
 */

#ifndef __CT_APP_STATES_H
#define __CT_APP_STATES_H

/**
 * @typedef app_state_t
 * @brief Application states
 *
 * App state definition which is used within app's to determine if app has been
 * activated or stopped by the main-function so async calls can be stop and
 * release their data gracefully.
 */
typedef enum {
    APP_STATE_UNDEF = 0,
    APP_STATE_ACTIVE,
    APP_STATE_STOPPED
} app_state_t;

/**
 * @def APP_STATE_NEXT(_w, _s, _t)
 * @brief Schedule next state _s in time _t on worker-queue _w
 */
#define APP_STATE_NEXT(_w, _s, _t) ({ \
    /* ensure previous functions have been cleared from queue */ \
    k_delayed_work_cancel(_w); \
    /* schedule new function */ \
    k_delayed_work_init(_w, _s); \
    k_delayed_work_submit(_w, _t); \
})

/**
 * @def APP_STATE_NOW(_w, _s)
 * @brief Schedule next state _s now on worker-queue _w
 */
#define APP_STATE_NOW(_w, _s) ({ \
    APP_STATE_NEXT(_w, _s, K_NO_WAIT); \
})

/**
 * @def APP_STATE_CLEAR(_w)
 * @brief Cancel any pending states on worker-queue _w
 */
#define APP_STATE_CLEAR(_w) ({ \
    k_delayed_work_cancel(_w); \
})

/**
 * @def APP_STATE_EXTEND(_w, _t)
 * @brief Postpone pending states on worker-queue _w with time _t
 */
#define APP_STATE_EXTEND(_w, _t) ({ \
    k_delayed_work_submit(_w, _t); \
})

/**
 * @def APP_STATE_REMAINING(_w,_t)
 * @brief Retrieving remaining time _t of next state on worker-queue _w
 *
 * Note that time _t is returned by reference.
 */
#define APP_STATE_REMAINING(_w,_t) ({ \
    *_t = k_delayed_work_remaining_get(_w); \
})

/**
 * @def APP_STATE_NEXT_WQ(_s, _t)
 * @brief Schedule next state _s in time _t.
 *
 * The used worker queue is implicitly provided by the caller.
 */
#define APP_STATE_NEXT_WQ(_s, _t) ({ \
    struct k_delayed_work *_w = CONTAINER_OF(work, struct k_delayed_work, work);\
    APP_STATE_NEXT(_w, _s, _t); \
})

/**
 * @def APP_STATE_NOW_WQ(_s)
 * @brief Schedule next state _s now
 *
 * The used worker queue is implicitly provided by the caller.
 */
#define APP_STATE_NOW_WQ(_s) ({ \
    struct k_delayed_work *_w = CONTAINER_OF(work, struct k_delayed_work, work);\
    APP_STATE_NOW(_w, _s); \
})

/**
 * @def APP_STATE_CLEAR_WQ()
 * @brief Cancel any pending states on worker-queue of the caller.
 */
#define APP_STATE_CLEAR_WQ() ({ \
    struct k_delayed_work *_w = CONTAINER_OF(work, struct k_delayed_work, work);\
    APP_STATE_CLEAR(_w); \
})

/**
 * @def APP_STATE_EXTEND_WQ(_t)
 * @brief Postpone pending states with time _t
 *
 * The used worker queue is implicitly provided by the caller.
 */
#define APP_STATE_EXTEND_WQ(_t) ({ \
    struct k_delayed_work *_w = CONTAINER_OF(work, struct k_delayed_work, work);\
    APP_STATE_EXTEND_WQ(_w, _t); \
})

/**
 * @def APP_STATE_REMAINING_WQ_t)
 * @brief Retrieving remaining time _t of next state
 *
 * Note that time _t is returned by reference.
 * The used worker queue is implicitly provided by the caller.
 */ 
#define APP_STATE_REMAINING_WQ(_t) ({ \
    struct k_delayed_work *_w = CONTAINER_OF(work, struct k_delayed_work, work);\
    APP_STATE_EXTEND_WQ(_w,_t); \
})

#endif /* __CT_APP_STATES_H */
```

## src/ct_crypto.c
```c
/*
 * This file is part of the Contact Tracing / GAEN Wearable distribution
 *        https://github.com/Sendrato/gaen-wearable.
 *
 * Copyright (c) 2020 Vincent van der Locht (https://www.synchronicit.nl/)
 *                    Hessel van der Molen  (https://sendrato.com/)
 *
 * This program is free software: you can redistribute it and/or modify
 * it under the terms of the GNU Affero General Public License as published by
 * the Free Software Foundation, version 3.
 *
 * This program is distributed in the hope that it will be useful, but
 * WITHOUT ANY WARRANTY; without even the implied warranty of
 * MERCHANTABILITY or FITNESS FOR A PARTICULAR PURPOSE. See the GNU
 * General Public License for more details.
 *
 * You should have received a copy of the GNU Affero General Public License along
 * with this program. If not, see <https://www.gnu.org/licenses/agpl-3.0.txt>.
 */

#include <tinycrypt/hkdf.h>
#include <tinycrypt/hmac.h>
#include <tinycrypt/hmac_prng.h>
#include <tinycrypt/sha256.h>
#include <tinycrypt/aes.h>
#include <tinycrypt/ctr_mode.h>
#include <tinycrypt/constants.h>

#include <stdio.h>
#include <stdlib.h>
#include <string.h>
#include <stdint.h>

#include <posix/time.h>
#include <posix/sys/time.h>

#include <zephyr.h>
#include <device.h>
#include <drivers/entropy.h>

#include <settings/settings.h>
#include <drivers/hwinfo.h>

#include "ct.h"
#include "ct_crypto.h"
#include "ct_settings.h"

static uint8_t psk_rpik[] = "EN-RPIK";
static uint8_t psk_rpi[]  = "EN-RPI";
static uint8_t psk_aemk[] = "EN-AEMK";


// ENIntervalNumber(..)
static uint32_t ct_crypto_intervalNumber(uint64_t time) {
    return time / (ct_priv.tek_rolling_interval);
}



uint32_t ct_crypto_intervalNumber_now(void)
{
    struct timespec ts;
    clock_gettime(CLOCK_REALTIME, &ts);
    return ct_crypto_intervalNumber(ts.tv_sec);
}



// When setting up the device for exposure detection, the first
//   Temporary Exposure Key is generated on the device and associated with an
//   ENIntervalNumber i, corresponding to the time from which the key is valid.
//   That value is aligned with the TEKRollingPeriod and is derived as follows:
uint32_t ct_crypto_intervalNumberAligned_now(void)
{
    return (ct_crypto_intervalNumber_now() / ct_priv.tek_rolling_period )
                * ct_priv.tek_rolling_period;
}



// The CRNG function designates a cryptographic random number generator:
// Output <-- CRNG(OutputLength)
// --
// NOTE: this function is adjusted to generate a random TEK of size TEK_SIZE.
static int ct_crypto_crng(uint8_t *tek)
{
    const struct device *dev;
    uint8_t hwid[12];
    uint8_t seed[32] = {0};
    uint32_t add_random[8];
    struct tc_hmac_prng_struct h;

    hwinfo_get_device_id((uint8_t*)hwid, sizeof(hwid));

    dev = device_get_binding(DT_CHOSEN_ZEPHYR_ENTROPY_LABEL);
    if (!dev) {
        printk("error: no random device\n");
    } else {
        entropy_get_entropy(dev,seed, sizeof(seed));
    }

    memset(&h, 0x0, sizeof(h));

    for(int i=0; i<ARRAY_SIZE(add_random);i++) {
        add_random[i] = k_cycle_get_32();
    }

    for(int i=1; i<ARRAY_SIZE(add_random);i++) {
        add_random[i] = add_random[i] * add_random[i-1];
    }

    (void) tc_hmac_prng_init(&h, hwid, sizeof(hwid));
    (void) tc_hmac_prng_reseed(&h, seed, sizeof(seed),
                    (uint8_t*)add_random, sizeof(add_random));
    (void) tc_hmac_prng_generate(tek, TEK_SIZE, &h);

    return 0;
}



// in-place generation of a new tek
int ct_crypto_calc_tek( uint8_t *tek )
{
    if(!tek)
        return -EINVAL;

    // A new tek is simply a cryptographic random number of size TEK_SIZE
    ct_crypto_crng(tek);

    return 0;
}



// HKDF designates the HKDF function as defined by IETF RFC 5869,
// using the SHA-256 hash function:
// Output <== HKDF(Key, Salt, Info, OutputLength)
// RPIK_i <== HKDF(tek-i, NULL, UTF8("EN-RPIK"), 16)
int ct_crypto_calc_rpik(uint8_t *tek, uint8_t *rpik)
{
    (void) hkdf_sha256(rpik, AEMK_SIZE,
                        tek, TEK_SIZE,
                        NULL, 0,
                        psk_rpik, strlen(psk_rpik));

    return 0;
}



// Rolling Proximity Identifiers are privacy-preserving identifiers that are
//  broadcast in Bluetooth payloads. Each time the Bluetooth Low Energy MAC
//  randomized address changes, we derive a new Rolling Proximity Identifier
//  using the Rolling Proximity Identifier Key:
// RPI_{i,j} <== AES128(RPIK_i,PaddedData_j)
// Where:
// - j is the Unix Epoch Time at the moment the roll occurs
// - ENIN_j <== ENIntervalNumber( j )
// - PaddedData is the following sequence of 16 bytes:
// - PaddedDataj[0...5] = UTF8("EN-RPI")
// - PaddedDataj[6...11] = 0x000000000000
// - PaddedDataj[12...15] = ENIN_j
int ct_crypto_calc_rpi(uint32_t enin_j, uint8_t *rpik, uint8_t *rpi)
{
    uint8_t padding[16];
    struct tc_aes_key_sched_struct s;

    for(int i=0;i<6;i++)
        padding[i] = psk_rpi[i];

    for(int i=6;i<12;i++)
        padding[i] = 0;

#if 1
    //Little Endianness
    *((uint32_t*)&padding[12]) = enin_j;
#else
    //Big Endianness
    padding[15] = (enin_j & 0x000000FF) >>  0;
    padding[14] = (enin_j & 0x0000FF00) >>  8;
    padding[13] = (enin_j & 0x00FF0000) >> 16;
    padding[12] = (enin_j & 0xFF000000) >> 24;
#endif

    (void) tc_aes128_set_encrypt_key(&s, rpik);
    (void) tc_aes_encrypt(rpi, padding, &s);

    return 0;
}



int ct_crypto_calc_aemk(uint8_t *tek, uint8_t *aemk)
{
    (void) hkdf_sha256(aemk, AEMK_SIZE,
                        tek, TEK_SIZE,
                        NULL, 0,
                        psk_aemk, strlen(psk_aemk));
    return 0;
}



int ct_crypto_calc_aem(uint8_t *aemk, uint8_t *rpi, uint8_t *metadata,
                    uint8_t *aem)
{
    struct tc_aes_key_sched_struct sched;

    (void) tc_aes128_set_encrypt_key(&sched, aemk);
    (void) tc_ctr_mode(aem, AEM_SIZE, metadata, META_SIZE, rpi, &sched);

    return 0;
}



int ct_crypto_init(void)
{
    return 0;
}
```

## src/ct_crypto.h
```c
/*
 * This file is part of the Contact Tracing / GAEN Wearable distribution
 *        https://github.com/Sendrato/gaen-wearable.
 *
 * Copyright (c) 2020 Vincent van der Locht (https://www.synchronicit.nl/)
 *                    Hessel van der Molen  (https://sendrato.com/)
 *
 * This program is free software: you can redistribute it and/or modify
 * it under the terms of the GNU Affero General Public License as published by
 * the Free Software Foundation, version 3.
 *
 * This program is distributed in the hope that it will be useful, but
 * WITHOUT ANY WARRANTY; without even the implied warranty of
 * MERCHANTABILITY or FITNESS FOR A PARTICULAR PURPOSE. See the GNU
 * General Public License for more details.
 *
 * You should have received a copy of the GNU Affero General Public License along
 * with this program. If not, see <https://www.gnu.org/licenses/agpl-3.0.txt>.
 */

/**
 * @file
 * @brief GAEN Crypto functions.
 */

#ifndef __CT_CRYPTO_H
#define __CT_CRYPTO_H

#include <string.h>
#include <zephyr/types.h>

/**
 * @brief Initialise crypto-system.
 * @return 0 on success, negative errno code on failure.
 */
int ct_crypto_init(void);

/**
 * @brief Compute a rolling interval number based on the current time.
 *
 * This function provides a number for each X minute time window that’s shared
 * between all devices participating in the protocol. These time windows are
 * derived from timestamps in Unix Epoch Time.
 *
 * The X minute time window is retrieved from the systems settings.
 *
 * @return Rolling interval number, a 32-bit, unsigned little-endian value.
 */
uint32_t ct_crypto_intervalNumber_now(void);

/**
 * @brief Compute an aligned rolling interval number based on the current time.
 *
 * When setting up the device for exposure detection, the first
 * Temporary Exposure Key is generated on the device and associated with an
 * ENIntervalNumber i, corresponding to the time from which the key is valid.
 * That value is aligned with the TEKRollingPeriod.
 *
 * @return Rolling interval number, a 32-bit, unsigned little-endian value.
 */
uint32_t ct_crypto_intervalNumberAligned_now(void);

/**
 * @brief Generate a new TEK
 *
 * @param [out] tek : pointer to a TEK_SIZE-byte array in which the TEK will be stored
 * @return 0 on success, negative errno code on failure.
 */
int ct_crypto_calc_tek( uint8_t *tek );

/**
* @brief Generate a new RPI-Key
*
* @param [in]  tek  : pointer to a TEK_SIZE-byte array containing currently active TEK.
* @param [out] rpik : pointer to a RPIK_SIZE-byte array in which the RPI-Key will be stored
* @return 0 on success, negative errno code on failure.
*/
int ct_crypto_calc_rpik(uint8_t *tek, uint8_t *rpik);

/**
* @brief Generate a new RPI
*
* @param [in]  ival : rolling-interval at which the RPI starts.
* @param [in]  rpik : pointer to a RPIK_SIZE-byte array containing the RPI-Key.
* @param [out] rpi  : pointer to a RPI_SIZE-byte array in which the RPI will be stored
* @return 0 on success, negative errno code on failure.
*/
int ct_crypto_calc_rpi(uint32_t ival, uint8_t *rpik, uint8_t *rpi);

/**
* @brief Generate a new AEM-Key
*
* @param [in]  tek  : pointer to a TEK_SIZE-byte array containing currently active TEK.
* @param [out] rpik : pointer to a AEMK_SIZE-byte array in which the AEM-Key will be stored
* @return 0 on success, negative errno code on failure.
*/
int ct_crypto_calc_aemk(uint8_t *tek, uint8_t *aemk);

/**
* @brief Generate a new AEM
*
* @param [in]  aemk : pointer to a AEMK_SIZE-byte array containing the AEM-Key.
* @param [in]  rpi  : pointer to a RPI_SIZE-byte array containing the RPI.
* @param [in]  meta : pointer to a META_SIZE-byte array containing the meta-data.
* @param [out] aem  : pointer to a AEM_SIZE-byte array in which the AEM will be stored
* @return 0 on success, negative errno code on failure.
*/
int ct_crypto_calc_aem(uint8_t *aemk, uint8_t *rpi, uint8_t *meta, uint8_t *aem);

#endif /* __CT_CRYPTO_H */
```

## src/ct_db.h
```c
/*
 * This file is part of the Contact Tracing / GAEN Wearable distribution
 *        https://github.com/Sendrato/gaen-wearable.
 *
 * Copyright (c) 2020 Vincent van der Locht (https://www.synchronicit.nl/)
 *                    Hessel van der Molen  (https://sendrato.com/)
 *
 * This program is free software: you can redistribute it and/or modify
 * it under the terms of the GNU Affero General Public License as published by
 * the Free Software Foundation, version 3.
 *
 * This program is distributed in the hope that it will be useful, but
 * WITHOUT ANY WARRANTY; without even the implied warranty of
 * MERCHANTABILITY or FITNESS FOR A PARTICULAR PURPOSE. See the GNU
 * General Public License for more details.
 *
 * You should have received a copy of the GNU Affero General Public License along
 * with this program. If not, see <https://www.gnu.org/licenses/agpl-3.0.txt>.
 */

/**
 * @file
 * @brief Data storage of TEKs and RPIs.
 */

#ifndef __CT_DB_H
#define __CT_DB_H

#include <string.h>
#include <zephyr/types.h>

#include <sys/slist.h>

/**
 * @brief Initialise database.
 * @return 0 on success, negative errno code on [flash] failure.
 */
int ct_db_init(void);

/**
 * @brief Perform a database-tick, allowing database to do data-management.
 *
 * Especially when using an external flash-chip, this tick is important as it
 * ensures that local buffers will be verified and pushed into the NVM.
 *
 * @param [in]  ival  : rolling-interval at which the tick is performed.
 * @return 0 on success, negative errno code on [flash] failure.
 */
int ct_db_tick(uint32_t ival);

/**
 * @brief Clear local buffers and (external) flash storage.
 * @return 0 on success, negative errno code on [flash] failure.
 */
int ct_db_clear(void);

/**
 * @brief Clear local TEK buffer.
 * @return 0 on success, negative errno code on failure.
 */
int ct_db_tek_clear(void);

/**
 * @brief Clear local RPI buffer.
 * @return 0 on success, negative errno code on failure.
 */
int ct_db_rpi_clear(void);

/**
 * @brief Add a new TEK to the database.
 *
 * @param [in]  tek   : pointer to a TEK_SIZE-byte array containing TEK.
 * @param [in]  ival  : rolling-interval at which the TEK starts.
 * @return 0 on success, negative errno code on [flash] failure.
 */
int ct_db_tek_add(uint8_t *tek, uint32_t ival);

/**
 * @brief Retrieve the number of stored TEKs.
 *
 * The return value is the sum of all TEKs stored in the local buffer and
 * stored in the external flash.
 *
 * @param [out]  cnt   : number of TEKs.
 * @return 0 on success, negative errno code on [flash] failure.
 */
int ct_db_tek_get_cnt(uint16_t *cnt);

/**
 * @brief Retrieve the n'th TEK from memory
 *
 * When n=0 the oldest TEK is retrieved. When n=n the newest TEK is retrieved.
 * If the n'th TEK does not exists, the values of `tek` and `ival` are undefined.
 *
 * @param [in]  n     : n'th value in which we are interested.
 * @param [out] tek   : pointer to a TEK_SIZE-byte array in which the TEK will be stored
 * @param [out] ival  : rolling-interval at which the TEK starts.
 * @return 0 on success, negative errno code on [flash] failure.
 */
int ct_db_tek_get(uint16_t n, uint8_t *tek, uint32_t *ival);

/**
 * @brief Retrieve the last TEK from memory
 *
 * @param [out] tek   : pointer to a TEK_SIZE-byte array in which the TEK will be stored
 * @param [out] ival  : rolling-interval at which the TEK starts.
 * @return 0 on success, negative errno code on [flash] failure.
 * @return -EINVAL when database is empty.
 */
int ct_db_tek_get_last(uint8_t *tek, uint32_t *ival);

/**
 * @brief Add a new RPI to the database.
 *
 * @param [in]  rpi   : pointer to a RPI_SIZE-byte array containing the RPI.
 * @param [in]  aem   : pointer to a AEM_SIZE-byte array containing the AEM.
 * @param [in]  rssi  : RSSI value at which the RPI is received [dB]
 * @param [in]  ival  : rolling-interval at which the RPI is received.
 * @return 0 on success, negative errno code on [flash] failure.
 */
int ct_db_rpi_add(uint8_t *rpi, uint8_t *aem, int8_t rssi, uint32_t ival);

/**
 * @brief Retrieve the number of stored RPIs.
 *
 * The return value is the sum of all RPIs stored in the local buffer and
 * stored in the external flash.
 *
 * @param [out]  cnt   : number of RPIs.
 * @return 0 on success, negative errno code on [flash] failure.
 */
int ct_db_rpi_get_cnt(uint16_t *cnt);

/**
 * @brief Retrieve the n'th RPI from memory
 *
 * When n=0 the oldest RPI is retrieved. When n=n the newest RPI is retrieved.
 * If the n'th RPI does not exists, the out-params are undefined.
 *
 * @param [in]  n     : n'th value in which we are interested.
 * @param [out] rpi   : pointer to a RPI_SIZE-byte array in which the RPI will be stored
 * @param [out] aem   : pointer to a AEM_SIZE-byte array in which the AEM will be stored
 * @param [out] rssi  : RSSI value at which the RPI is received [dB].
 * @param [out] cnt   : number of observations.
 * @param [out] ival  : highest rolling-interval at which the RPI is observed.
 * @return 0 on success, negative errno code on [flash] failure.
 */
int ct_db_rpi_get(uint16_t n, uint8_t *rpi, uint8_t *aem, int8_t *rssi,
                uint8_t *cnt, uint32_t *ival_last);

#endif /* __CT_DB_H */
```

## src/ct_settings.h
```c
/*
 * This file is part of the Contact Tracing / GAEN Wearable distribution
 *        https://github.com/Sendrato/gaen-wearable.
 *
 * Copyright (c) 2020 Vincent van der Locht (https://www.synchronicit.nl/)
 *                    Hessel van der Molen  (https://sendrato.com/)
 *
 * This program is free software: you can redistribute it and/or modify
 * it under the terms of the GNU Affero General Public License as published by
 * the Free Software Foundation, version 3.
 *
 * This program is distributed in the hope that it will be useful, but
 * WITHOUT ANY WARRANTY; without even the implied warranty of
 * MERCHANTABILITY or FITNESS FOR A PARTICULAR PURPOSE. See the GNU
 * General Public License for more details.
 *
 * You should have received a copy of the GNU Affero General Public License along
 * with this program. If not, see <https://www.gnu.org/licenses/agpl-3.0.txt>.
 */

/**
 * @file
 * @brief Handlers for system settings stored in NVM.
 */

#ifndef __CT_SETTINGS_H
#define __CT_SETTINGS_H

#include <string.h>
#include <zephyr/types.h>

struct ct_settings {
    uint32_t adv_period;
    uint32_t scan_period;

    // BLE advertisement settings in steps of 0.625 [ms].
    uint16_t adv_ival_min;
    uint16_t adv_ival_max;

    // BLE scanning settings in steps of 0.625 [ms].
    uint16_t scan_ival;
    uint16_t scan_window;

    // Discretisation steps in second in which time is sliced.
    // Default is 10 mintues (600sec)
    uint32_t tek_rolling_interval;

    // The rolling-period is the duration for which a Temporary Exposure Key
    //  is valid (in multiples of TEK_ROLLING_INTERVAL). In the default config
    //  rolling-period is defined as 144, achieving a key validity of 24 hours.
    uint32_t tek_rolling_period;

    // Name of device
    unsigned char device_name[10];
};

extern struct ct_settings ct_priv;

#endif /* __CT_SETTINGS_H */
```
